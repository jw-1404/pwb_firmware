/*
 * Copyright (c) 2020 Phytec Messtechnik GmbH
 *
 * SPDX-License-Identifier: Apache-2.0
 */

&usart1 {
	status = "okay";

	modbus0 {
		compatible = "zephyr,modbus-serial";
		status = "okay";
		/* de-gpios = <&arduino_header 15 GPIO_ACTIVE_LOW>;	*/
	};
};
