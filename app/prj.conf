## CMakeLists.txt
```
cmake_minimum_required(VERSION 3.20.0)

find_package(Zephyr REQUIRED HINTS $ENV{ZEPHYR_BASE})
project(pwb_firmware)

FILE(GLOB app_sources src/*.c)
target_sources(app PRIVATE ${app_sources})
```

## prj.conf
```kconfig
CONFIG_SENSOR=y
CONFIG_W1=y
CONFIG_I2C=y
CONFIG_DAC=y
CONFIG_ADC=y
CONFIG_GPIO=y

CONFIG_MODBUS=y
CONFIG_MODBUS_ROLE_SERVER=y

# CONFIG_LOG=y

### debug config ###
# CONFIG_UART_CONSOLE=n
# CONFIG_USE_SEGGER_RTT=y
# CONFIG_RTT_CONSOLE=y
```

## app.overlay
```dts
// /{
// 	chosen {
// 		zephyr,console = &usart3;
// 		zephyr,shell-uart = &usart3;
//   };
// };

// &usart3 {
//   status = "okay";
// };
```

## src/main.c
```c
/*
 * Init and start the modbus server.
 * - this is the last step in firmware start-up
 * - the actual work in response to coil & register changes is dispatched to system work queue immediately
 * - coil & register reading return the current status of internal registers (see modbus_ifc.h for all available registers)
 *
 */

#include "common.h"

#include <zephyr/drivers/sensor.h>
#include <zephyr/kernel.h>
#include <zephyr/modbus/modbus.h>
#include <zephyr/sys/printk.h>
#include <zephyr/sys/util.h>

////// k_work to process coil/register commands
struct ctrl_cmd_t {
  struct k_work work;
  uint8_t addr;
};

static struct ctrl_cmd_t coil_cmd = {.addr = ARRAY_SIZE(coil_reg)};
void coil_work_handler(struct k_work *item) {
  struct ctrl_cmd_t *the_cmd = CONTAINER_OF(item, struct ctrl_cmd_t, work);
  COIL_REG_HANDLER_FOREACH(handler) { handler->callback(the_cmd->addr); }

  return;
}

static struct ctrl_cmd_t register_cmd = {.addr = ARRAY_SIZE(holding_reg)};
void register_work_handler(struct k_work *item) {
  struct ctrl_cmd_t *the_cmd = CONTAINER_OF(item, struct ctrl_cmd_t, work);
  HOLDING_REG_HANDLER_FOREACH(handler) { handler->callback(the_cmd->addr); }

  return;
}

static int coil_rd(uint16_t addr, bool *state) {
  if (addr >= ARRAY_SIZE(coil_reg)) {
    return -ENOTSUP;
  }

  *state = coil_reg[addr]->value;
  printk("Coil read, addr %u, %d", addr, (int)*state);

  return 0;
}

static int coil_wr(uint16_t addr, bool state) {
  if (addr >= ARRAY_SIZE(coil_reg)) {
    return -ENOTSUP;
  }

  // [todo] cmds without effects, just return
  /* if ((addr == REG_UPDATE_INTERVAL) && (reg == holding_reg[addr]->value)) { */
  /*   return 0; */
  /* } */

  //
  coil_reg[addr]->value=state;

  coil_cmd.addr = addr;
  k_work_submit(&coil_cmd.work);

  printk("Coil write, addr %u, %d", addr, (int)state);

  return 0;
}

static int holding_reg_rd(uint16_t addr, uint16_t *reg) {
  if (addr >= ARRAY_SIZE(holding_reg)) {
    return -ENOTSUP;
  }

  *reg = holding_reg[addr]->value;

  printk("Holding register read, addr %u", addr);

  return 0;
}

static int holding_reg_wr(uint16_t addr, uint16_t reg) {
  if (addr >= ARRAY_SIZE(holding_reg)) {
    return -ENOTSUP;
  }

  // cmds without effects, just return
  if ((addr == REG_UPDATE_INTERVAL) && (reg == holding_reg[addr]->value)) {
    return 0;
  }

  //
  holding_reg[addr]->value = reg;

  register_cmd.addr = addr;
  k_work_submit(&register_cmd.work);

  printk("Holding register write, addr %u", addr);

  return 0;
}

static struct modbus_user_callbacks mbs_cbs = {
    .coil_rd = coil_rd,
    .coil_wr = coil_wr,
    .holding_reg_rd = holding_reg_rd,
    .holding_reg_wr = holding_reg_wr,
};

const static struct modbus_iface_param server_param = {
    .mode = MODBUS_MODE_RTU,
    .server =
        {
            .user_cb = &mbs_cbs,
            .unit_id = 1,
        },
    .serial =
        {
            .baud = 19200,
            .parity = UART_CFG_PARITY_NONE,
        },
};

#define MODBUS_NODE DT_COMPAT_GET_ANY_STATUS_OKAY(zephyr_modbus_serial)

static int init_modbus_server(void) {
  const char iface_name[] = {DEVICE_DT_NAME(MODBUS_NODE)};
  int iface;

  iface = modbus_iface_get_by_name(iface_name);

  if (iface < 0) {
    printk("Failed to get iface index for %s", iface_name);
    return iface;
  }

  return modbus_init_server(iface, server_param);
}

/* only init & start the modbus server in main thread */
int main(void) {

  k_work_init(&coil_cmd.work, coil_work_handler);
  k_work_init(&register_cmd.work, register_work_handler);

  if (init_modbus_server()) {
    printk("Modbus RTU server initialization failed");
  }

  return 0;
}
```

## src/common.h
```c
#pragma once

#include "modbus_ifc.h"
#include <iterables/callback.h>
#include <iterables/register.h>

extern struct holding_register_t* holding_reg[REG_END];
extern struct coil_register_t* coil_reg[COIL_END];
```

## src/dac.c
```c
#ifdef CONFIG_DAC_AD5541

#include "common.h"

#include <zephyr/device.h>
#include <zephyr/drivers/dac.h>
#include <zephyr/kernel.h>
#include <zephyr/sys/util.h>

#define DAC_NUM 4
#define DAC_LABEL_PREFIX volt_ch

static const struct device *dac_dev[DAC_NUM];

/* coil register handler */
#define SWITCH_ONOFF_VOLTAGE(id)                                               \
  if (coil_reg[COIL_TRIPPED_CH##id]->value)                                    \
    return;                                                                    \
  if (coil_reg[COIL_ONOFF_CH##id]->value)                                      \
    dac_write_value(dac_dev[id], 0, holding_reg[REG_SVV_CH##id]->value);       \
  else                                                                         \
    dac_write_value(dac_dev[id], 0, 0)

static void dac_coil_register_handler(uint8_t addr) {
  switch (addr) {
  case COIL_ONOFF_CH0:
    SWITCH_ONOFF_VOLTAGE(0);
    break;
  case COIL_ONOFF_CH1:
    SWITCH_ONOFF_VOLTAGE(1);
    break;
  case COIL_ONOFF_CH2:
    SWITCH_ONOFF_VOLTAGE(2);
    break;
  case COIL_ONOFF_CH3:
    SWITCH_ONOFF_VOLTAGE(3);
    break;
  }

  return;
}

COIL_REG_HANDLER_DEFINE(dac_coil_reg, dac_coil_register_handler);

/* holding register handler */
#define UPDATE_VOLTAGE(id)                                                     \
  if (coil_reg[COIL_TRIPPED_CH##id]->value ||                                  \
      !coil_reg[COIL_ONOFF_CH##id]->value)                                     \
    return;                                                                    \
  dac_write_value(dac_dev[id], 0, holding_reg[REG_SVV_CH##id]->value)

static void dac_holding_register_handler(uint8_t addr) {
  switch (addr) {
  case REG_SVV_CH0:
    UPDATE_VOLTAGE(0);
    break;
  case REG_SVV_CH1:
    UPDATE_VOLTAGE(1);
    break;
  case REG_SVV_CH2:
    UPDATE_VOLTAGE(2);
    break;
  case REG_SVV_CH3:
    UPDATE_VOLTAGE(3);
    break;
  }

  return;
}

HOLDING_REG_HANDLER_DEFINE(dac_holding_reg, dac_holding_register_handler);

/* init func */
#define CHECK_DAC_READINESS(index, prefix)                                     \
  dac_dev[index] = DEVICE_DT_GET(DT_NODELABEL(prefix##index));                 \
  if (!device_is_ready(dac_dev[index])) {                                      \
    printk("\nError: Device \"%s\" is not ready; "                             \
           "check the driver initialization logs for errors.\n",               \
           dac_dev[index]->name);                                              \
    return -ENOENT;                                                            \
  }


static int dac_init(void) {
  LISTIFY(DAC_NUM, CHECK_DAC_READINESS, (), DAC_LABEL_PREFIX);
  return 0;
}

SYS_INIT(dac_init, APPLICATION, CONFIG_APPLICATION_INIT_PRIORITY);

#endif
```

## src/ds18s20.c
```c
#ifdef CONFIG_DS18S20

#include "common.h"

#include <zephyr/device.h>
#include <zephyr/devicetree.h>
#include <zephyr/drivers/sensor.h>
#include <zephyr/drivers/sensor/w1_sensor.h>
#include <zephyr/sys/util.h>

#define DS18S20_NODE DT_COMPAT_GET_ANY_STATUS_OKAY(maxim_ds18s20)
static const struct device *dev;

//
static int ds18s20_init(void) {

  dev = DEVICE_DT_GET(DS18S20_NODE);

  if (!device_is_ready(dev)) {
    printk("\nError: Device \"%s\" is not ready; "
           "check the driver initialization logs for errors.\n",
           dev->name);
    return -ENOENT;
  }

  struct sensor_value rom_id;
  sensor_attr_get(dev, SENSOR_CHAN_MAX, SENSOR_ATTR_W1_ROM, &rom_id);

  holding_reg[REG_BOARD_UUID + 3]->value = rom_id.val1 & BIT_MASK(16);
  holding_reg[REG_BOARD_UUID + 2]->value = (rom_id.val1 >> 16) & BIT_MASK(16);
  holding_reg[REG_BOARD_UUID + 1]->value = rom_id.val2 & BIT_MASK(16);
  holding_reg[REG_BOARD_UUID]->value = (rom_id.val2 >> 16) & BIT_MASK(16);

  printk("UUID (ROM id): %08x %08x\n", rom_id.val2, rom_id.val1);

  return 0;
}

SYS_INIT(ds18s20_init, APPLICATION, CONFIG_APPLICATION_INIT_PRIORITY);

#endif
```

## src/ds18s20_init.c
```c
#ifdef CONFIG_DS18S20

#include "common.h"
#include <zephyr/device.h>
#include <zephyr/devicetree.h>
#include <zephyr/drivers/sensor.h>
#include <zephyr/drivers/sensor/w1_sensor.h>
#include <zephyr/kernel.h>
#include <zephyr/sys/util.h>

static int ds18s20_init(void) {
  const struct device *const dev = DEVICE_DT_GET(DS18S20_NODE);

  if (dev == NULL) {
    /* No such node, or the node does not have status "okay". */
    printk("\nError: no device found.\n");
    return -ENOENT;
  }

  if (!device_is_ready(dev)) {
    printk("\nError: Device \"%s\" is not ready; "
           "check the driver initialization logs for errors.\n",
           dev->name);
    return -ENOENT;
  }

  struct sensor_value rom_id;
  sensor_attr_get(dev, SENSOR_CHAN_MAX, SENSOR_ATTR_W1_ROM, &rom_id);

  holding_reg[REG_BOARD_UUID+3]= rom_id.val1 & BIT_MASK(16);
  holding_reg[REG_BOARD_UUID+2] = (rom_id.val1 >> 16) & BIT_MASK(16);
  holding_reg[REG_BOARD_UUID+1] = rom_id.val2 & BIT_MASK(16);
  holding_reg[REG_BOARD_UUID] = (rom_id.val2 >> 16) & BIT_MASK(16);

  printk("UUID (ROM id): %08x %08x\n", rom_id.val2, rom_id.val1);

  return 0;
}

SYS_INIT(ds18s20_init, APPLICATION, CONFIG_APPLICATION_INIT_PRIORITY);

#endif
```

## src/heartbeat.c
```c
#include "common.h"

#include <zephyr/kernel.h>

// in ms
#define HB_COUNTING_PERIOD 1000

static uint32_t hb_counts = 0;

/* heartbeat timer */
static void hb_timer_callback(struct k_timer *timer) {
  uint32_t _cv = ++hb_counts;
  holding_reg[REG_HEARTBEAT_LW]->value = _cv & BIT_MASK(16);
  holding_reg[REG_HEARTBEAT_HI]->value = _cv >> 16;
}

static K_TIMER_DEFINE(hb_timer, hb_timer_callback, NULL);

/* start the timer */
static int heartbeat_init(void) {
  k_timer_start(&hb_timer, K_NO_WAIT, K_MSEC(HB_COUNTING_PERIOD));
  return 0;
}

SYS_INIT(heartbeat_init, APPLICATION, CONFIG_APPLICATION_INIT_PRIORITY);
```

## src/heartbeat_timer.c
```c
#include "common.h"

#include <zephyr/kernel.h>

// in ms
#define HB_COUNTING_PERIOD 1000

static uint32_t hb_counts = 0;

/* heartbeat timer */
static void hb_timer_callback(struct k_timer *timer) {
  uint32_t _cv = ++hb_counts;
  holding_reg[REG_HEARTBEAT_LW]->value = _cv & BIT_MASK(16);
  holding_reg[REG_HEARTBEAT_HI]->value = _cv >> 16;

  printk("I'm alive (%d)\n", hb_counts);
}

static K_TIMER_DEFINE(hb_timer, hb_timer_callback, NULL);

/* start the timer */
static int heartbeat_init(void) {
  k_timer_start(&hb_timer, K_NO_WAIT, K_MSEC(HB_COUNTING_PERIOD));
  return 0;
}

SYS_INIT(heartbeat_init, APPLICATION, CONFIG_APPLICATION_INIT_PRIORITY);
```

## src/measure_timer.c
```c
#ifdef CONFIG_ADC_LTC2450

/*
 * LTC2450-1 has fixed conversion time.
 * In order not blocking the default measure polling (in system queue),
 * measurement reading is better implemented in separate timer and work
 * queue.
 *
 */

#include "common.h"

#include <zephyr/device.h>
#include <zephyr/drivers/adc.h>
#include <zephyr/drivers/gpio.h>
#include <zephyr/kernel.h>

#define ADC_NODE DT_COMPAT_GET_ANY_STATUS_OKAY(lltc_ltc2450)
#define ENCODER_NODE DT_COMPAT_GET_ANY_STATUS_OKAY(gpio_encoder)

/* should be more frequent than other peripheral's status update */
#define MEASUREMENT_PERIOD 500

/* hardcoded mapping from encoder ch to internal register addr (fixed in PCB design) */
const static uint16_t measure_ch_map[] = {REG_PVV_CH0, REG_PVI_CH0, REG_PVV_CH1,
                                          REG_PVI_CH1, REG_PVI_CH3, REG_PVV_CH3,
                                          REG_PVI_CH2, REG_PVV_CH2};

/* set the current adc channel */
const static struct gpio_dt_spec encoder_gpio[] = {
    GPIO_DT_SPEC_GET_BY_IDX(ENCODER_NODE, gpios, 0),
    GPIO_DT_SPEC_GET_BY_IDX(ENCODER_NODE, gpios, 1),
    GPIO_DT_SPEC_GET_BY_IDX(ENCODER_NODE, gpios, 2)};

#define SET_ENCODER_ADDR(index, ch)                                            \
  gpio_pin_configure_dt(encoder_gpio + index, (ch >> index) & BIT_MASK(1)            \
                                            ? GPIO_OUTPUT_ACTIVE               \
                                            : GPIO_OUTPUT_INACTIVE)
inline static void choose_adc_ch(uint8_t ch) {
  SET_ENCODER_ADDR(0, ch);
  SET_ENCODER_ADDR(1, ch);
  SET_ENCODER_ADDR(2, ch);
  return;
}

/* read one channel's current measurement */
const static struct device *adc_dev = DEVICE_DT_GET(ADC_NODE);

// [todo] rtn err code?
inline static void read_adc_ch(int ch) {
  // select ch
  choose_adc_ch(ch);

  // read current conversion
  uint16_t buf;
  struct adc_sequence sequence = {
      .buffer = &buf,
      .buffer_size = sizeof(buf),
  };
  int err = adc_read(adc_dev, &sequence);
  if (err < 0) {
    printk("Could not read current conversion value (%d)\n", err);
    return;
  }

  // update corresponding regs
  holding_reg[measure_ch_map[ch]]->value = buf;
  /* printk("new adc meaure (ch%d): %d\n", ch, buf); */

  return;
}

/* work handler for measurement timer */
static void measure_work_handler(struct k_work *work) {

  for (int ch = 0; ch < ARRAY_SIZE(measure_ch_map); ch++) {
    read_adc_ch(ch);
  }

  return;
}

K_WORK_DEFINE(measure_work, measure_work_handler);

static void measure_timer_callback(struct k_timer *timer) {
  /* immediately submit to system work queue */
  // current to system queue, better in separate work queue
  k_work_submit(&measure_work);
}

static K_TIMER_DEFINE(measure_timer, measure_timer_callback, NULL);

/* holding register handler */
static void measure_holding_register_handler(uint8_t addr) {
  if (addr == REG_MEASURE_INTERVAL) {
    k_timer_start(&measure_timer, K_NO_WAIT, K_MSEC(holding_reg[addr]->value));
  }
  return;
}

HOLDING_REG_HANDLER_DEFINE(measure_holding_reg,
                           measure_holding_register_handler);

/* start the timer */
static int measure_init(void) {

  // check encoder
  for (int i = 0; i < ARRAY_SIZE(encoder_gpio); i++) {
    if (!gpio_is_ready_dt(encoder_gpio + i)) {
      printk("The encoder GPIO port is not ready.\n");
      return -ENOENT;
    }
  }

  // check adc
  if (!device_is_ready(adc_dev)) {
    printk("ADC device %s is not ready\n", adc_dev->name);
    return -ENOENT;
  }

  // init measurement interval
  holding_reg[REG_MEASURE_INTERVAL]->value = MEASUREMENT_PERIOD;

  // start measurement
  k_timer_start(&measure_timer, K_NO_WAIT,
                K_MSEC(holding_reg[REG_MEASURE_INTERVAL]->value));

  return 0;
}

SYS_INIT(measure_init, APPLICATION, CONFIG_APPLICATION_INIT_PRIORITY);

#endif
```

## src/modbus.c
```c
/*
 * Init and start the modbus server.
 * - this is the last step in firmware start-up
 * - the actual work in response to coil & register changes is dispatched to system work queue immediately
 * - coil & register reading return the current status of internal registers (see modbus_ifc.h for all available registers)
 *
 */

#include "common.h"

#include <zephyr/drivers/sensor.h>
#include <zephyr/kernel.h>
#include <zephyr/modbus/modbus.h>
#include <zephyr/sys/printk.h>
#include <zephyr/sys/util.h>

////// k_work to process coil/register commands
struct ctrl_cmd_t {
  struct k_work work;
  uint8_t addr;
};

static struct ctrl_cmd_t coil_cmd = {.addr = ARRAY_SIZE(coil_reg)};
void coil_work_handler(struct k_work *item) {
  struct ctrl_cmd_t *the_cmd = CONTAINER_OF(item, struct ctrl_cmd_t, work);
  COIL_REG_HANDLER_FOREACH(handler) { handler->callback(the_cmd->addr); }

  return;
}

static struct ctrl_cmd_t register_cmd = {.addr = ARRAY_SIZE(holding_reg)};
void register_work_handler(struct k_work *item) {
  struct ctrl_cmd_t *the_cmd = CONTAINER_OF(item, struct ctrl_cmd_t, work);
  HOLDING_REG_HANDLER_FOREACH(handler) { handler->callback(the_cmd->addr); }

  return;
}

static int coil_rd(uint16_t addr, bool *state) {
  if (addr >= ARRAY_SIZE(coil_reg)) {
    return -ENOTSUP;
  }

  *state = coil_reg[addr]->value;
  printk("Coil read, addr %u, %d", addr, (int)*state);

  return 0;
}

static int coil_wr(uint16_t addr, bool state) {
  if (addr >= ARRAY_SIZE(coil_reg)) {
    return -ENOTSUP;
  }

  // cmds without effects, just return
  if (state == coil_reg[addr]->value) {
    return 0;
  }

  //
  coil_reg[addr]->value=state;

  coil_cmd.addr = addr;
  k_work_submit(&coil_cmd.work);

  printk("Coil write, addr %u, %d", addr, (int)state);

  return 0;
}

static int holding_reg_rd(uint16_t addr, uint16_t *reg) {
  if (addr >= ARRAY_SIZE(holding_reg)) {
    return -ENOTSUP;
  }

  *reg = holding_reg[addr]->value;

  printk("Holding register read, addr %u", addr);

  return 0;
}

static int holding_reg_wr(uint16_t addr, uint16_t reg) {
  if (addr >= ARRAY_SIZE(holding_reg)) {
    return -ENOTSUP;
  }

  // cmds without effects, just return
  if ((addr == REG_UPDATE_INTERVAL) && (reg == holding_reg[addr]->value)) {
    return 0;
  }

  //
  holding_reg[addr]->value = reg;

  register_cmd.addr = addr;
  k_work_submit(&register_cmd.work);

  printk("Holding register write, addr %u", addr);

  return 0;
}

static struct modbus_user_callbacks mbs_cbs = {
    .coil_rd = coil_rd,
    .coil_wr = coil_wr,
    .holding_reg_rd = holding_reg_rd,
    .holding_reg_wr = holding_reg_wr,
};

const static struct modbus_iface_param server_param = {
    .mode = MODBUS_MODE_RTU,
    .server =
        {
            .user_cb = &mbs_cbs,
            .unit_id = 1,
        },
    .serial =
        {
            .baud = 19200,
            .parity = UART_CFG_PARITY_NONE,
        },
};

#define MODBUS_NODE DT_COMPAT_GET_ANY_STATUS_OKAY(zephyr_modbus_serial)

static int init_modbus_server(void) {
  const char iface_name[] = {DEVICE_DT_NAME(MODBUS_NODE)};
  int iface;

  iface = modbus_iface_get_by_name(iface_name);

  if (iface < 0) {
    printk("Failed to get iface index for %s", iface_name);
    return iface;
  }
  printk("mb iface: %s\n", iface_name);

  return modbus_init_server(iface, server_param);
}

/* only init & start the modbus server in main thread */
int main(void) {

  k_work_init(&coil_cmd.work, coil_work_handler);
  k_work_init(&register_cmd.work, register_work_handler);

  printk("mb server init\n");
  if (init_modbus_server()) {
    printk("Modbus RTU server initialization failed");
  }

  return 0;
}
```

## src/modbus_ifc.h
```c
#pragma once

/*** holding registers ***/

/// status registers
// voltage set value (V)
#define REG_SVV_CH0 0
#define REG_SVV_CH1 1
#define REG_SVV_CH2 2
#define REG_SVV_CH3 3

// voltage present value (V)
#define REG_PVV_CH0 4
#define REG_PVV_CH1 5
#define REG_PVV_CH2 6
#define REG_PVV_CH3 7

// current present value (uA)
#define REG_PVI_CH0 8
#define REG_PVI_CH1 9
#define REG_PVI_CH2 10
#define REG_PVI_CH3 11

// trip current settings (uA)
#define REG_TRIP_CH0 12
#define REG_TRIP_CH1 13
#define REG_TRIP_CH2 14
#define REG_TRIP_CH3 15

// ramp up/down settings (step in V)
#define REG_RUP_STEP 16
#define REG_RDN_STEP 17

// status polling interval (in ms)
#define REG_UPDATE_INTERVAL 18

// system alive time (high-16 bits & low-16 bits)
/// alive-time = polling-times * update_interval
#define REG_HEARTBEAT_LW 19
#define REG_HEARTBEAT_HI 20

// others
#define REG_TEMPERATURE_INT 21
#define REG_TEMPERATURE_FLT 22
#define REG_HUMIDITY_INT 23
#define REG_HUMIDITY_FLT 24
// 64-bit uuid, addr range (little endian): 25-28
#define REG_BOARD_UUID 25

// control command registers
#define REG_CLR_TRIPS 29
#define REG_RESET 30

// V and I measurment interval (better shorter than REG_UPDATE_INTERVAL)
#define REG_MEASURE_INTERVAL 31

#define REG_END 32

/*** coils ***/

/// status coils
// voltage tripped or not
#define COIL_TRIPPED_CH0 0
#define COIL_TRIPPED_CH1 1
#define COIL_TRIPPED_CH2 2
#define COIL_TRIPPED_CH3 3

/// control command coils
// turn voltage on/off
#define COIL_ONOFF_CH0 4
#define COIL_ONOFF_CH1 5
#define COIL_ONOFF_CH2 6
#define COIL_ONOFF_CH3 7

#define COIL_END 8
```

## src/registers.c
```c
#include "common.h"
#include <zephyr/sys/util.h>

/* define the internal registers */
// [todo] over-skilled, better use STRUCT_SECTION_ITERABLE_ARRAY
LISTIFY(REG_END, HOLDING_REG_DEFINE, (;) , 0);
LISTIFY(COIL_END, COIL_REG_DEFINE, (;), false);

/* these global pointers as stubs to internal registers */
// [todo] ugly, define a macro for in-place fetching as needed (see zephyr's device.h impl)
struct holding_register_t *holding_reg[REG_END];
struct coil_register_t *coil_reg[COIL_END];

// initialize stub register pointers
static int registers_init(void)
{
  for (int i = 0; i < REG_END; i++) {
    STRUCT_SECTION_GET(holding_register_t, i, holding_reg + i);
  }
  for (int i = 0; i < COIL_END; i++) {
    STRUCT_SECTION_GET(coil_register_t, i, coil_reg + i);
  }
  return 0;
}

SYS_INIT(registers_init, POST_KERNEL, CONFIG_APPLICATION_INIT_PRIORITY);
```

## src/registers.h
```c
#pragma once

/*** holding registers ***/

/// status registers
// voltage set value (V)
#define REG_SVV_CH1 0
#define REG_SVV_CH2 1
#define REG_SVV_CH3 2
#define REG_SVV_CH4 3

// voltage present value (V)
#define REG_PVV_CH1 4
#define REG_PVV_CH2 5
#define REG_PVV_CH3 6
#define REG_PVV_CH4 7

// current present value (uA)
#define REG_PVI_CH1 8
#define REG_PVI_CH2 9
#define REG_PVI_CH3 10
#define REG_PVI_CH4 11

// trip current settings (uA)
#define REG_TRIP_CH1 12
#define REG_TRIP_CH2 13
#define REG_TRIP_CH3 14
#define REG_TRIP_CH4 15

// ramp up/down settings (step in V)
#define REG_RUP_STEP 16
#define REG_RDN_STEP 17

// status polling interval (in ms)
#define REG_UPDATE_INTERVAL 18

// system alive time (high-16 bits & low-16 bits)
/// alive-time = polling-times * update_interval
#define REG_ALIVE_HI 19
#define REG_ALIVE_LW 20

// others
#define REG_TEMPERATURE_INT 21
#define REG_TEMPERATURE_FLT 22
#define REG_HUMIDITY_INT 23
#define REG_HUMIDITY_FLT 24
// 64-bit uuid, addr range (little endian): 25-28
#define REG_BOARD_UUID 25

/// control command registers
#define REG_CLR_TRIPS 29
#define REG_RESET 30

#define REG_END 31

/*** coils ***/

/// status coils
// voltage tripped or not
#define COIL_TRIPPED_CH1 0
#define COIL_TRIPPED_CH2 1
#define COIL_TRIPPED_CH3 2
#define COIL_TRIPPED_CH4 3

/// control command coils
// turn voltage on/off
#define COIL_ONOFF_CH1 4
#define COIL_ONOFF_CH2 5
#define COIL_ONOFF_CH3 6
#define COIL_ONOFF_CH4 7

#define COIL_END 8
```

## src/sht3xa.c
```c
#ifdef CONFIG_SHT3XD

#include "common.h"

#include <zephyr/device.h>
#include <zephyr/drivers/sensor.h>
#include <zephyr/kernel.h>

#define SHT3XA_NODE DT_COMPAT_GET_ANY_STATUS_OKAY(sensirion_sht3xd)
static const struct device *dev;

/* status polling handler */
static void sht3xa_poll()
{
  struct sensor_value temp, hum;
  sensor_sample_fetch(dev);
  sensor_channel_get(dev, SENSOR_CHAN_AMBIENT_TEMP, &temp);
  sensor_channel_get(dev, SENSOR_CHAN_HUMIDITY, &hum);
  holding_reg[REG_TEMPERATURE_INT]->value = temp.val1 & BIT_MASK(16);
  holding_reg[REG_TEMPERATURE_FLT]->value = temp.val2 & BIT_MASK(16); // = flt/1000000
  holding_reg[REG_HUMIDITY_INT]->value = hum.val1 & BIT_MASK(16);
  holding_reg[REG_HUMIDITY_FLT]->value = hum.val2 & BIT_MASK(16); // = flt/1000000

  printk("new sensor value %d\n", temp.val1);
  return;
}

POLL_HANDLER_DEFINE(sht3xa_poll, sht3xa_poll);

//
static int sht3xa_init(void) {
  dev = DEVICE_DT_GET(SHT3XA_NODE);

  if (!device_is_ready(dev)) {
    printk("\nError: Device \"%s\" is not ready; "
           "check the driver initialization logs for errors.\n",
           dev->name);
    return -ENOENT;
  }

  return 0;
}

SYS_INIT(sht3xa_init, APPLICATION, CONFIG_APPLICATION_INIT_PRIORITY);

#endif
```
