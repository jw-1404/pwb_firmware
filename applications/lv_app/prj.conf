## CMakeLists.txt
```
cmake_minimum_required(VERSION 3.20.0)

find_package(Zephyr REQUIRED HINTS $ENV{ZEPHYR_BASE})
project(lvb_app)

FILE(GLOB app_sources src/*.c)
target_sources(app PRIVATE ${app_sources})
```

## prj.conf
```kconfig
CONFIG_GPIO=y
CONFIG_MODBUS=y
CONFIG_MODBUS_ROLE_SERVER=y

CONFIG_LOG=y

### debug config ###
CONFIG_UART_CONSOLE=n
CONFIG_USE_SEGGER_RTT=y
CONFIG_RTT_CONSOLE=y
```

## app.overlay
```dts
// /{
// 	chosen {
// 		zephyr,console = &usart3;
// 		zephyr,shell-uart = &usart3;
//   };
// };
```

## src/heartbeat.c
```c
#include "common.h"

#include <zephyr/kernel.h>

// in ms
#define HB_COUNTING_PERIOD 1000

static uint32_t hb_counts = 0;

/* heartbeat timer */
static void hb_timer_callback(struct k_timer *timer) {
  uint32_t _cv = ++hb_counts;
  holding_reg[REG_HEARTBEAT_LW]->value = _cv & BIT_MASK(16);
  holding_reg[REG_HEARTBEAT_HI]->value = _cv >> 16;

  //  printk("heart beat: %d\n", hb_counts);
}

static K_TIMER_DEFINE(hb_timer, hb_timer_callback, NULL);

/* start the timer */
static int heartbeat_init(void) {
  k_timer_start(&hb_timer, K_NO_WAIT, K_MSEC(HB_COUNTING_PERIOD));
  return 0;
}

SYS_INIT(heartbeat_init, APPLICATION, CONFIG_APPLICATION_INIT_PRIORITY);
```

## src/measure.c
```c
#include "common.h"

#include <zephyr/device.h>
#include <zephyr/drivers/adc.h>
#include <zephyr/drivers/gpio.h>
#include <zephyr/kernel.h>

/* unit: ms */
#define MEASUREMENT_PERIOD 150
#define MEASUREMENT_TIMEs 30

#if !DT_NODE_EXISTS(DT_PATH(zephyr_user)) ||            \
  !DT_NODE_HAS_PROP(DT_PATH(zephyr_user), io_channels)
#error "No suitable devicetree overlay specified"
#endif

/* use DT_FOREACH_PROP_ELEM in combination with ADC_DT_SPEC_GET_BY_IDX, see adc_dt sample; io-channel must be used */
#define DT_SPEC_AND_COMMA(node_id, prop, idx)   \
	ADC_DT_SPEC_GET_BY_IDX(node_id, idx),

/* 0-9: voltage, 10-19: current */
static const struct adc_dt_spec adc_channels[] = {
	DT_FOREACH_PROP_ELEM(DT_PATH(zephyr_user), io_channels,
                       DT_SPEC_AND_COMMA)
};

/* hardcoded mapping from encoder ch to internal register addr (fixed in PCB design) */
const static uint16_t voltage_ch_map[] = {REG_PVV_CH0, REG_PVV_CH1, REG_PVV_CH2,
                                          REG_PVV_CH3, REG_PVV_CH4, REG_PVV_CH5,
                                          REG_PVV_CH6, REG_PVV_CH7, REG_PVV_CH8,
                                          REG_PVV_CH9};
const static uint16_t current_ch_map[] = {REG_PVI_CH0, REG_PVI_CH1, REG_PVI_CH2,
                                          REG_PVI_CH3, REG_PVI_CH4, REG_PVI_CH5,
                                          REG_PVI_CH6, REG_PVI_CH7, REG_PVI_CH8,
                                          REG_PVI_CH9};
// [todo] should be calibrated for each board
const static uint16_t current_zero_offset[] = { 1822, 1682, 1640, 1730, 1715,
                                                1707, 1812, 1717, 1670, 1662};

static int32_t voltage_cache[ARRAY_SIZE(voltage_ch_map)];
static int32_t current_cache[ARRAY_SIZE(current_ch_map)];
static int32_t cache_counter = 0;

// [todo] rtn err code?
inline static void read_voltage() {
  int err;
  uint16_t buf;
  struct adc_sequence sequence = {
      .buffer = &buf,
      .buffer_size = sizeof(buf),
  };

  for (size_t i = 0U; i < ARRAY_SIZE(voltage_ch_map); i++) {
    (void)adc_sequence_init_dt(&adc_channels[i], &sequence);

    err = adc_read_dt(&adc_channels[i], &sequence);
    if (err < 0) {
      printk("Could not read voltage value at ch_%d (%d)\n", i+1, err);
      return;
    }

    // [todo] value conversion

    // update corresponding regs
    if (cache_counter == (MEASUREMENT_TIMEs-1)) {
      uint16_t tmp_cache = voltage_cache[i] / MEASUREMENT_TIMEs;
      if (i<5) {
        holding_reg[voltage_ch_map[i]]->value = 3300.0 / 4096 * tmp_cache * 5.6;
      }
      else
        holding_reg[voltage_ch_map[i]]->value = 3300.0/4096*tmp_cache*2.34;
      voltage_cache[i] = 0;
      printk("voltage %d: %d\n", i + 1, holding_reg[voltage_ch_map[i]]->value);
    }
    else {
      voltage_cache[i] += buf;
    }
  }

  return;
}

inline static void read_current() {
  int err;
  uint16_t buf;
  struct adc_sequence sequence = {
      .buffer = &buf,
      .buffer_size = sizeof(buf),
  };

  size_t start_index = ARRAY_SIZE(voltage_ch_map);
  for (size_t i = start_index; i < ARRAY_SIZE(adc_channels); i++) {
    //    printk("ch_%d\n", i + 1);
    (void)adc_sequence_init_dt(&adc_channels[i], &sequence);
    err = adc_read_dt(&adc_channels[i], &sequence);
    if (err < 0) {
      printk("Could not read current value at ch_%d (%d)\n", i + 1, err);
      return;
    }

    // [todo] value conversion
    /* int32_t val_mv = (int32_t)buf; */
    /* err = adc_raw_to_millivolts_dt(&adc_channels[i], &val_mv); */
    /* /\* conversion to mV may not be supported, skip if not *\/ */
    /* if (err < 0) { */
    /*   printk(" (value in mV not available)\n"); */
    /* } else { */
    /*   printk(" = %" PRId32 " mV\n", val_mv); */
    /* } */

    // update corresponding regs
    if (cache_counter == (MEASUREMENT_TIMEs-1)) {
      uint16_t tmp_cache = current_cache[i - start_index] / MEASUREMENT_TIMEs;
      if (tmp_cache < current_zero_offset[i - start_index]){
        tmp_cache = 0;
      }
      else {
        tmp_cache -= current_zero_offset[i - start_index];
      }

      /* holding_reg[current_ch_map[i - start_index]]->value = tmp_cache*16.0 -
       * 25000; */
      holding_reg[current_ch_map[i - start_index]]->value = tmp_cache*16.0;
      current_cache[i-start_index] = 0;
      printk("current %d: %d\n", i + 1, holding_reg[current_ch_map[i-start_index]]->value);
    }
    else {
      current_cache[i-start_index] += buf;
    }
  }

  return;
}
/* work handler for measurement timer */
static void measure_work_handler(struct k_work *work) {
  read_current();
  read_voltage();

  if(cache_counter == (MEASUREMENT_TIMEs-1))
    cache_counter = 0;
  else
    cache_counter++;

  return;
}

K_WORK_DEFINE(measure_work, measure_work_handler);

static void measure_timer_callback(struct k_timer *timer) {
  /* immediately submit to system work queue */
  // current to system queue, better in separate work queue
  k_work_submit(&measure_work);
}

static K_TIMER_DEFINE(measure_timer, measure_timer_callback, NULL);

/* holding register handler */
static void measure_holding_register_handler(uint8_t addr) {
  if (addr == REG_MEASURE_INTERVAL) {
    k_timer_start(&measure_timer, K_NO_WAIT, K_MSEC(holding_reg[addr]->value));
  }
  return;
}

HOLDING_REG_HANDLER_DEFINE(measure_holding_reg,
                           measure_holding_register_handler);

/* start the timer */
static int measure_init(void) {

  // init measurement interval
  holding_reg[REG_MEASURE_INTERVAL]->value = MEASUREMENT_PERIOD;

  for (int i = 0; i < ARRAY_SIZE(adc_channels); i++) {
    if (!adc_is_ready_dt(&adc_channels[i])) {
      printk("ADC controller device %s not ready\n", adc_channels[i].dev->name);
      return -ENOENT;
    }
    int err = adc_channel_setup_dt(&adc_channels[i]);
    if (err < 0) {
      printk("Could not setup channel #%d (%d)\n", i, err);
      return err;
    }
  }

  // start measurement
  k_timer_start(&measure_timer, K_NO_WAIT,
                K_MSEC(MEASUREMENT_PERIOD));

  return 0;
}

SYS_INIT(measure_init, APPLICATION, CONFIG_APPLICATION_INIT_PRIORITY);
```

## src/modbus.c
```c
/*
 * Init and start the modbus server.
 * - this is the last step in firmware start-up
 * - the actual work in response to coil & register changes is dispatched to system work queue immediately
 * - coil & register reading return the current status of internal registers (see modbus_ifc.h for all available registers)
 *
 */

#include "common.h"

#include <zephyr/kernel.h>
#include <zephyr/modbus/modbus.h>
#include <zephyr/sys/printk.h>
#include <zephyr/sys/util.h>

////// k_work to process coil/register commands
struct ctrl_cmd_t {
  struct k_work work;
  uint8_t addr;
};

static struct ctrl_cmd_t coil_cmd = {.addr = ARRAY_SIZE(coil_reg)};
void coil_work_handler(struct k_work *item) {
  struct ctrl_cmd_t *the_cmd = CONTAINER_OF(item, struct ctrl_cmd_t, work);
  COIL_REG_HANDLER_FOREACH(handler) { handler->callback(the_cmd->addr); }

  return;
}

static struct ctrl_cmd_t register_cmd = {.addr = ARRAY_SIZE(holding_reg)};
void register_work_handler(struct k_work *item) {
  struct ctrl_cmd_t *the_cmd = CONTAINER_OF(item, struct ctrl_cmd_t, work);
  HOLDING_REG_HANDLER_FOREACH(handler) { handler->callback(the_cmd->addr); }

  return;
}

static int coil_rd(uint16_t addr, bool *state) {
  if (addr >= ARRAY_SIZE(coil_reg)) {
    return -ENOTSUP;
  }

  *state = coil_reg[addr]->value;
  printk("Coil read, addr %u, %d", addr, (int)*state);

  return 0;
}

static int coil_wr(uint16_t addr, bool state) {
  if (addr >= ARRAY_SIZE(coil_reg)) {
    return -ENOTSUP;
  }

  // cmds without effects, just return
  if (state == coil_reg[addr]->value) {
    return 0;
  }

  //
  coil_reg[addr]->value=state;

  coil_cmd.addr = addr;
  k_work_submit(&coil_cmd.work);

  printk("Coil write, addr %u, %d", addr, (int)state);

  return 0;
}

static int holding_reg_rd(uint16_t addr, uint16_t *reg) {
  if (addr >= ARRAY_SIZE(holding_reg)) {
    return -ENOTSUP;
  }

  *reg = holding_reg[addr]->value;

  printk("Holding register read, addr %u", addr);

  return 0;
}

static int holding_reg_wr(uint16_t addr, uint16_t reg) {
  if (addr >= ARRAY_SIZE(holding_reg)) {
    return -ENOTSUP;
  }

  // cmds without effects, just return
  if ((addr == REG_MEASURE_INTERVAL) && (reg == holding_reg[addr]->value)) {
    return 0;
  }

  //
  holding_reg[addr]->value = reg;

  register_cmd.addr = addr;
  k_work_submit(&register_cmd.work);

  printk("Holding register write, addr %u", addr);

  return 0;
}

static struct modbus_user_callbacks mbs_cbs = {
    .coil_rd = coil_rd,
    .coil_wr = coil_wr,
    .holding_reg_rd = holding_reg_rd,
    .holding_reg_wr = holding_reg_wr,
};

const static struct modbus_iface_param server_param = {
    .mode = MODBUS_MODE_RTU,
    .server =
        {
            .user_cb = &mbs_cbs,
            .unit_id = 1,
        },
    .serial =
        {
            .baud = 19200,
            .parity = UART_CFG_PARITY_NONE,
        },
};

#define MODBUS_NODE DT_COMPAT_GET_ANY_STATUS_OKAY(zephyr_modbus_serial)

static int init_modbus_server(void) {
  const char iface_name[] = {DEVICE_DT_NAME(MODBUS_NODE)};
  int iface;

  iface = modbus_iface_get_by_name(iface_name);

  if (iface < 0) {
    printk("Failed to get iface index for %s", iface_name);
    return iface;
  }

  return modbus_init_server(iface, server_param);
}

/* only init & start the modbus server in main thread */
int main(void) {

  k_work_init(&coil_cmd.work, coil_work_handler);
  k_work_init(&register_cmd.work, register_work_handler);

  if (init_modbus_server()) {
    printk("Modbus RTU server initialization failed");
  }

  return 0;
}
```

## src/modbus_ifc.h
```c
#pragma once

/*** holding registers ***/

// voltage value
#define REG_PVV_CH0 0
#define REG_PVV_CH1 1
#define REG_PVV_CH2 2
#define REG_PVV_CH3 3
#define REG_PVV_CH4 4
#define REG_PVV_CH5 5
#define REG_PVV_CH6 6
#define REG_PVV_CH7 7
#define REG_PVV_CH8 8
#define REG_PVV_CH9 9

// current value
#define REG_PVI_CH0 10
#define REG_PVI_CH1 11
#define REG_PVI_CH2 12
#define REG_PVI_CH3 13
#define REG_PVI_CH4 14
#define REG_PVI_CH5 15
#define REG_PVI_CH6 16
#define REG_PVI_CH7 17
#define REG_PVI_CH8 18
#define REG_PVI_CH9 19

// measuring interval (in ms)
#define REG_MEASURE_INTERVAL 20

// system alive time (high-16 bits & low-16 bits)
#define REG_HEARTBEAT_LW 21
#define REG_HEARTBEAT_HI 22

#define REG_END 23

/*** coils ***/

// turn voltage on/off
#define COIL_ONOFF_CH0 0
#define COIL_ONOFF_CH1 1
#define COIL_ONOFF_CH2 2
#define COIL_ONOFF_CH3 3
#define COIL_ONOFF_CH4 4
#define COIL_ONOFF_CH5 5
#define COIL_ONOFF_CH6 6
#define COIL_ONOFF_CH7 7
#define COIL_ONOFF_CH8 8
#define COIL_ONOFF_CH9 9

#define COIL_END 10
```

## src/power.c
```c
#include "common.h"
#include "modbus_ifc.h"

#include <zephyr/drivers/gpio.h>
#include <zephyr/kernel.h>
#include <zephyr/device.h>
#include <zephyr/devicetree.h>
#include <zephyr/sys/printk.h>

/* #if !DT_NODE_EXISTS(DT_NODELABEL(powers)) */
/* #error "compiler: dts node with lablel powers not defined" */
/* #else */
/* #define VALVE_NODE DT_NODELABEL(powers) */
/* #endif */

/* try: DT_FOREACH_PROP_ELEM in combination with GPIO_DT_SPEC_GET_BY_IDX; propery name customizable */
static const struct gpio_dt_spec pwr0 = GPIO_DT_SPEC_GET(DT_ALIAS(pwr2), gpios); // [bug]: ch1 and ch3 swaped
static const struct gpio_dt_spec pwr1 = GPIO_DT_SPEC_GET(DT_ALIAS(pwr1), gpios);
static const struct gpio_dt_spec pwr2 = GPIO_DT_SPEC_GET(DT_ALIAS(pwr0), gpios);
static const struct gpio_dt_spec pwr3 = GPIO_DT_SPEC_GET(DT_ALIAS(pwr3), gpios);
static const struct gpio_dt_spec pwr4 = GPIO_DT_SPEC_GET(DT_ALIAS(pwr4), gpios);
static const struct gpio_dt_spec pwr5 = GPIO_DT_SPEC_GET(DT_ALIAS(pwr5), gpios);
static const struct gpio_dt_spec pwr6 = GPIO_DT_SPEC_GET(DT_ALIAS(pwr6), gpios);
static const struct gpio_dt_spec pwr7 = GPIO_DT_SPEC_GET(DT_ALIAS(pwr7), gpios);
static const struct gpio_dt_spec pwr8 = GPIO_DT_SPEC_GET(DT_ALIAS(pwr8), gpios);
static const struct gpio_dt_spec pwr9 = GPIO_DT_SPEC_GET(DT_ALIAS(pwr9), gpios);

static void power_coil_register_handler(uint8_t addr) {
  switch (addr) {
    case COIL_ONOFF_CH0:
      /* gpio_pin_configure_dt(&pwr0, coil_reg[COIL_ONOFF_CH0]->value */
      /*                       ? GPIO_OUTPUT_ACTIVE */
      /*                       : GPIO_OUTPUT_INACTIVE); */
      coil_reg[COIL_ONOFF_CH0]->value = true;
      break;
    case COIL_ONOFF_CH1:
      gpio_pin_configure_dt(&pwr1, coil_reg[COIL_ONOFF_CH1]->value
                                       ? GPIO_OUTPUT_ACTIVE
                                       : GPIO_OUTPUT_INACTIVE);
      break;
    // CHno effect on CH0, it's always on
    case COIL_ONOFF_CH2:
      gpio_pin_configure_dt(&pwr2, coil_reg[COIL_ONOFF_CH2]->value
                                       ? GPIO_OUTPUT_ACTIVE
                                       : GPIO_OUTPUT_INACTIVE);
      break;
    case COIL_ONOFF_CH3:
      gpio_pin_configure_dt(&pwr3, coil_reg[COIL_ONOFF_CH3]->value
                                       ? GPIO_OUTPUT_ACTIVE
                                       : GPIO_OUTPUT_INACTIVE);
      break;
    case COIL_ONOFF_CH4:
      gpio_pin_configure_dt(&pwr4, coil_reg[COIL_ONOFF_CH4]->value
                                       ? GPIO_OUTPUT_ACTIVE
                                       : GPIO_OUTPUT_INACTIVE);
      break;
    case COIL_ONOFF_CH5:
      gpio_pin_configure_dt(&pwr5, coil_reg[COIL_ONOFF_CH5]->value
                                       ? GPIO_OUTPUT_ACTIVE
                                       : GPIO_OUTPUT_INACTIVE);
      break;
    case COIL_ONOFF_CH6:
      gpio_pin_configure_dt(&pwr6, coil_reg[COIL_ONOFF_CH6]->value
                                       ? GPIO_OUTPUT_ACTIVE
                                       : GPIO_OUTPUT_INACTIVE);
      break;
    case COIL_ONOFF_CH7:
      gpio_pin_configure_dt(&pwr7, coil_reg[COIL_ONOFF_CH7]->value
                                       ? GPIO_OUTPUT_ACTIVE
                                       : GPIO_OUTPUT_INACTIVE);
      break;
    case COIL_ONOFF_CH8:
      gpio_pin_configure_dt(&pwr8, coil_reg[COIL_ONOFF_CH8]->value
                                       ? GPIO_OUTPUT_ACTIVE
                                       : GPIO_OUTPUT_INACTIVE);
      break;
    case COIL_ONOFF_CH9:
      gpio_pin_configure_dt(&pwr9, coil_reg[COIL_ONOFF_CH9]->value
                                       ? GPIO_OUTPUT_ACTIVE
                                       : GPIO_OUTPUT_INACTIVE);
      break;
  }

  return;
}

COIL_REG_HANDLER_DEFINE(power_coil_reg, power_coil_register_handler);

static int power_init(void) {

  if (!gpio_is_ready_dt(&pwr1) ||
      !gpio_is_ready_dt(&pwr2) ||
      !gpio_is_ready_dt(&pwr3) ||
      !gpio_is_ready_dt(&pwr4) ||
      !gpio_is_ready_dt(&pwr5) ||
      !gpio_is_ready_dt(&pwr6) ||
      !gpio_is_ready_dt(&pwr7) ||
      !gpio_is_ready_dt(&pwr8) ||
      !gpio_is_ready_dt(&pwr9) ||
      !gpio_is_ready_dt(&pwr0)) {
    printk("The valve GPIO port is not ready.\n");
    return -ENOENT;
  }

	gpio_pin_configure_dt(&pwr0, GPIO_OUTPUT_ACTIVE); coil_reg[COIL_ONOFF_CH0]->value = true;
	gpio_pin_configure_dt(&pwr1, GPIO_OUTPUT_ACTIVE); coil_reg[COIL_ONOFF_CH1]->value = true;
	gpio_pin_configure_dt(&pwr2, GPIO_OUTPUT_ACTIVE); coil_reg[COIL_ONOFF_CH2]->value = true;
	gpio_pin_configure_dt(&pwr3, GPIO_OUTPUT_ACTIVE); coil_reg[COIL_ONOFF_CH3]->value = true;
	gpio_pin_configure_dt(&pwr4, GPIO_OUTPUT_ACTIVE); coil_reg[COIL_ONOFF_CH4]->value = true;
	gpio_pin_configure_dt(&pwr5, GPIO_OUTPUT_ACTIVE); coil_reg[COIL_ONOFF_CH5]->value = true;
	gpio_pin_configure_dt(&pwr6, GPIO_OUTPUT_ACTIVE); coil_reg[COIL_ONOFF_CH6]->value = true;
	gpio_pin_configure_dt(&pwr7, GPIO_OUTPUT_ACTIVE); coil_reg[COIL_ONOFF_CH7]->value = true;
	gpio_pin_configure_dt(&pwr8, GPIO_OUTPUT_ACTIVE); coil_reg[COIL_ONOFF_CH8]->value = true;
	gpio_pin_configure_dt(&pwr9, GPIO_OUTPUT_ACTIVE); coil_reg[COIL_ONOFF_CH9]->value = true;

  return 0;
}

SYS_INIT(power_init, APPLICATION, CONFIG_APPLICATION_INIT_PRIORITY);
```

## src/registers.c
```c
#include "common.h"

#include <zephyr/sys/util.h>

/* define the internal registers */
// [todo] over-skilled, better use STRUCT_SECTION_ITERABLE_ARRAY
LISTIFY(REG_END, HOLDING_REG_DEFINE, (;), 0);
LISTIFY(COIL_END, COIL_REG_DEFINE, (;), false);

/* these global pointers as stubs to internal registers */
// [todo] ugly, define a macro for in-place fetching as needed (see zephyr's
// device.h impl)
struct holding_register_t *holding_reg[REG_END];
struct coil_register_t *coil_reg[COIL_END];

// initialize stub register pointers
static int registers_init(void) {
  for (int i = 0; i < REG_END; i++) {
    STRUCT_SECTION_GET(holding_register_t, i, holding_reg + i);
  }
  for (int i = 0; i < COIL_END; i++) {
    STRUCT_SECTION_GET(coil_register_t, i, coil_reg + i);
  }
  return 0;
}

SYS_INIT(registers_init, POST_KERNEL, CONFIG_APPLICATION_INIT_PRIORITY);
```
