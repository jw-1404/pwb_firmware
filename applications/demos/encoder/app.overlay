
/{
    adc_encoder: adc_encoder {
        compatible = "gpio-encoder";
        gpios = <&gpioa 2  (GPIO_PULL_DOWN | GPIO_ACTIVE_HIGH)>,
                <&gpioa 12 (GPIO_PULL_DOWN | GPIO_ACTIVE_HIGH)>,
                <&gpioa 11 (GPIO_PULL_DOWN | GPIO_ACTIVE_HIGH)>;
        // status = "okay";
    };
};