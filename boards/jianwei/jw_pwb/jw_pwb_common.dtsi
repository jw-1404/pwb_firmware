/* common settings */

/{
  adc_encoder: adc_encoder {
    compatible = "gpio-encoder";
    status = "disabled";
  };

  w1_bus: w1_bus {
    compatible = "zephyr,w1-gpio";
    status = "disabled";

    uuid_device: uuid_device {
      compatible = "maxim,ds18s20";
	    family-code = <0x10>;
	    status = "okay";
    };
  };

};