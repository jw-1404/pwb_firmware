## boards/jianwei/jw_pwb/Kconfig.jw_pwb
```kconfig
config BOARD_JW_PWB
	select SOC_STM32F051X8 if BOARD_JW_PWB_STM32F051X8
	select SOC_STM32F103XB if BOARD_JW_PWB_STM32F103XB
```

## boards/jianwei/jw_pwb/board.yml
```yaml
board:
  name: jw_pwb
  vendor: jianwei
  socs:
    - name: stm32f051x8
    - name: stm32f103xb
```

## boards/jianwei/jw_pwb/jw_pwb_stm32f051x8_defconfig
```kconfig
# Kernel Options due to Low Memory (8k)
CONFIG_MAIN_STACK_SIZE=640
CONFIG_IDLE_STACK_SIZE=200
CONFIG_ISR_STACK_SIZE=512
# Prevent Interrupt Vector Table in RAM
CONFIG_SRAM_VECTOR_TABLE=n
```

## boards/jianwei/jw_pwb/jw_pwb_stm32f103xb_defconfig
```kconfig
# Serial Drivers
CONFIG_SERIAL=y
CONFIG_CONSOLE=y
CONFIG_UART_CONSOLE=y

# needed by modbus implementation
CONFIG_UART_INTERRUPT_DRIVEN=y

# GPIO Controller
CONFIG_GPIO=y

# Enable Clocks
CONFIG_CLOCK_CONTROL=y

# enable pin controller
CONFIG_PINCTRL=y
```

## drivers/adc/Kconfig.ltc2450
```kconfig
config ADC_LTC2450
	bool "Linear Technology ltc2450-1 ADC driver"
	default y
	select SPI
	depends on DT_HAS_LLTC_LTC2450_ENABLED
  help
    Enable the driver for the ltc2450-1 ADC

if ADC_LTC2450

config ADC_LTC2450_INIT_PRIORITY
	int "Init priority"
	default 80
	help
    It's initialized after SPI controller (default: 70)

config ADC_LTC2450_CONVERSION_MS
  int "Wait time (in ms) for ltc2450 conversion job, 21 ms at least"
  default 50

endif # ADC_LTC2450
```

## drivers/dac/Kconfig.ad5541
```kconfig
config DAC_AD5541
	bool "Analog Devices AD5541 DAC driver"
	default y
	select SPI
	depends on DT_HAS_ADI_AD5541_ENABLED
  help
    Enable the driver for the Analog Devices AD5541 DAC

if DAC_AD5541

config DAC_AD5541_INIT_PRIORITY
	int "Init priority"
	default 80
	help
    It's initialized after SPI controller (default: 70)

config DAC_AD5541_CS_DELAY
  int "Delay (us) in CS holding before and after transmission"
  default 10

endif # DAC_AD5541
```

## drivers/sensor/ds18s20/Kconfig
```kconfig
# DS18S20 temperature and humidity sensor configuration options
# - hard fork of zephyr's ds18b20 driver
# - with
#   - correct temperature conversion
#   - rom id attributes getting & fetching
# - without
#   - alarm bytes setting & reading

# Copyright (c) 2022 Thomas Stranger
# Copyright (c) 2024 Yong Zhou
# SPDX-License-Identifier: Apache-2.0

config DS18S20
	bool "DS18S20 Temperature Sensor"
	default y
	depends on DT_HAS_MAXIM_DS18S20_ENABLED
	depends on W1_NET
	help
	  Enable driver for DS18S20 1-Wire temperature sensors.
```

## dts/bindings/adc/lltc,ltc2450.yaml
```yaml
# Copyright (C) 2024 Yong Zhou <zyong06@gmail.com>

description: Linear Technology LTC2450-1 ADC

compatible: "lltc,ltc2450"

include: [spi-device.yaml]
```

## dts/bindings/custom/gpio-encoder.yaml
```yaml
description: |
  A generic binding for a GPIO-controlled encoder (i.e. multiplexer like tmux1108).
  It does not target a specific device or vender.

  Example definition for a 8:1 encoder with 3 address lines:

    gpio-encoder-example {
        compatible = "gpio-encoder";
        gpios = <&gpioa 4 (GPIO_PULL_DOWN | GPIO_ACTIVE_HIGH)>,
                <&gpioa 5 (GPIO_PULL_DOWN | GPIO_ACTIVE_HIGH)>,
                <&gpiob 8 (GPIO_PULL_DOWN | GPIO_ACTIVE_HIGH)>;
    };

compatible: "gpio-encoder"

properties:
  gpios:
    type: phandle-array
    required: true
    description: |
      The array of GPIO pins acting as input pins of the encoder
```

## dts/bindings/dac/adi,ad5541.yaml
```yaml
# Copyright (C) 2024 Yong Zhou <zyong06@gmail.com>
# SPDX-License-Identifier: Apache-2.0

include: [spi-device.yaml]

description: Analog Devices 12-Bit DAC

compatible: "adi,ad5541"
```

## dts/bindings/sensor/jw,ds18s20.yaml
```yaml
# Copyright (c) 2021, Thomas Stranger
# Copyright (c) 2021, Yong Zhou
# SPDX-License-Identifier: Apache-2.0

description: JianWei's custom maxim DS18S20 1-Wire temperature sensor

compatible: "jw,ds18s20"

include: [sensor-device.yaml, w1-slave.yaml]
```

## dts/bindings/sensor/maxim,ds18s20.yaml
```yaml
# Copyright (c) 2021, Thomas Stranger
# Copyright (c) 2021, Yong Zhou
# SPDX-License-Identifier: Apache-2.0

description: Maxim DS18S20 1-Wire temperature sensor

compatible: "maxim,ds18s20"

include: [sensor-device.yaml, w1-slave.yaml]
```

## west.yml
```yaml
# SPDX-License-Identifier: Apache-2.0

manifest:
  self:
    west-commands: scripts/west-commands.yml

  remotes:
    - name: zephyrproject-rtos
      url-base: https://github.com/zephyrproject-rtos

  projects:
    - name: zephyr
      remote: zephyrproject-rtos
      revision: v3.7.0-rc1
      import:
        # By using name-allowlist we can clone only the modules that are
        # strictly needed by the application.
        name-allowlist:
          - mcuboot
          - cmsis      # required by the ARM port
          - hal_stm32  # required by the jw_pwb board (STM32 based)
          - segger     # required by RTT viewer
```
